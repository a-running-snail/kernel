/dts-v1/;
#include "mt6739.dtsi"
#include "cust.dtsi"
#include "hxytech/g1860ph.dtsi"
/ {
	chosen {
		bootargs = "console=tty0 console=ttyMT0,921600n1 root=/dev/ram initrd=0x44000000,\
0x1000000 loglevel=8 androidboot.selinux=permissive androidboot.hardware=mt6739 initcall_debug=1";
		/* fpga may has no lk, we need to specify display info here */
		/* fb buffer is reserved using this dts by memory node above */

		atag,videolfb-fb_base_l = <0x5e605000>;
		atag,videolfb-fb_base_h = <0>;
		atag,videolfb-islcmfound = <1>;
		atag,videolfb-islcm_inited = <0>;
		atag,videolfb-fps= <6000>;
		atag,videolfb-vramSize= <0x017bb000>;
		atag,videolfb-lcmname= "nt35521_hd_dsi_vdo_truly_nt50358_drv";
	};
};




## kernel-4.4/drivers/input/fingerprint/cdfinger/Kconfig
```kconfig
config FINGERPRINT_GFX1XM
        bool "FINGERPRINT_GFX1XM"
        depends on CUSTOM_KERNEL_FINGERPRINT
        default y
        help
          gfx1xm driver
```

## kernel-4.4/drivers/input/touchscreen/mediatek/Kconfig
```kconfig
#
# Touchscreen driver configuration
#
menuconfig INPUT_TOUCHSCREEN
	bool "Touchscreens"
	help
	  Say Y here, and a list of supported touchscreens will be displayed.
	  This option doesn't affect the kernel.

	  If unsure, say Y.

if INPUT_TOUCHSCREEN

config TOUCHSCREEN_MTK
	bool "MediaTek Touch Panel Driver"
	help
	  Say Y here if you have MediaTek touch panel.

	  If unsure, say N.

	  To compile this dirver as a module, choose M here: the
	  module will be called.

config TOUCHSCREEN_MTK_HXCHIPSET
	bool "HXCHIPSET for Mediatek package"
	default n
	help
	  Say Y here if you have HXCHIPSET touch panel.
	  If unsure, say N.
	  To compile this dirver as a module, choose M here: the
	  module will be called.
	  
source "drivers/input/touchscreen/mediatek/hxchipset/Kconfig"

config TOUCHSCREEN_MTK_MSG2836
	bool "MSG2836 for Mediatek package"
	default n
	help
	  Say Y here if you have MSG2836 touch panel.

	  If unsure, say N.

	  To compile this dirver as a module, choose M here: the
	  module will be called.
	  
config TOUCHSCREEN_MTK_FOCALTECH_TS
	bool "FT8006 for Mediatek package"
	default n
	help
	  Say Y here if you have FT8006 touch panel.

	  If unsure, say N.

	  To compile this dirver as a module, choose M here: the
	  module will be called.
source "drivers/input/touchscreen/mediatek/focaltech_touch/Kconfig"

config TOUCHSCREEN_MTK_FOCALTECH_TS_NEW
	bool "FT3427 for Mediatek package"
	default n
	help
	  Say Y here if you have FT3427 touch panel.

	  If unsure, say N.

	  To compile this dirver as a module, choose M here: the
	  module will be called.
source "drivers/input/touchscreen/mediatek/focaltech_touch_new/Kconfig"

config TOUCHSCREEN_MTK_GT1151
	bool "GT1151 for Mediatek package"
	default n
	help
	  Say Y here if you have GT1151 touch panel.

	  If unsure, say N.

	  To compile this dirver as a module, choose M here: the
	  module will be called.

config TOUCHSCREEN_MTK_PHYSICAL_ROTATION_HW
	bool "MediaTek Touch Panel Rotation"
	default n
	help
	  Say Y here if touch panel is physically rotated.
	  Physically rotated means that this driver will map
	  the reported coordination to diagonal position.

	  If unsure, say N.


source "drivers/input/touchscreen/mediatek/GT1151/Kconfig"

config TOUCHSCREEN_MTK_GT911
	bool "GT911 for Mediatek package"
	help
	  Say Y here if you have GT911 touch panel.

	  If unsure, say N.

source "drivers/input/touchscreen/mediatek/GT911/Kconfig"

config TOUCHSCREEN_MTK_GSLX680
	bool "gslX680 for Mediatek package"
	help
	  Say Y here if you have gslX680 touch panel.

	  If unsure, say N.
config TOUCHSCREEN_MTK_FT6X36
	bool "ft6x36 for Mediatek package"
	help
	  Say Y here if you have ft6x36 touch panel.
	  If unsure, say N.
source "drivers/input/touchscreen/mediatek/ft6x36/Kconfig"

endif
```
